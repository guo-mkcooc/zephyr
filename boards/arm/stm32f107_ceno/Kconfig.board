## boards/arm/stm32f107_ceno/Kconfig.board
```kconfig
# Kconfig - STM3210C-EVAL board configuration
#
# Copyright (c) 2016 RnDity Sp. z o.o.
#
# SPDX-License-Identifier: Apache-2.0
#

config BOARD_STM32F107_CENO
	bool "STM32f107_ceno dev Board"
	depends on SOC_STM32F107XC
```

## boards/arm/stm32f107_ceno/Kconfig.defconfig
```kconfig
# Kconfig - STM3210C-EVAL board configuration
#
# Copyright (c) 2016 RnDity Sp. z o.o.
#
# SPDX-License-Identifier: Apache-2.0
#

if BOARD_STM32F107_CENO

config BOARD
	default stm32f107_ceno

endif # BOARD_STM3210C_EVAL
```
